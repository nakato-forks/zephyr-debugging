## boards/nicekeyboards/nice_nano/Kconfig
```kconfig
# SPDX-License-Identifier: MIT

if BOARD_NICE_NANO_V2

config BT_CTLR
	default BT

if USB_DEVICE_STACK

config UART_CONSOLE
	default CONSOLE

config USB_DEVICE_INITIALIZE_AT_BOOT
	default y

endif # USB_DEVICE_STACK

endif # BOARD_NICE_NANO_V2
```

## boards/nicekeyboards/nice_nano/Kconfig.nice_nano_v2
```kconfig
# nice!nano board configuration

# Copyright (c) 2020 Pete Johanson
# SPDX-License-Identifier: MIT

config BOARD_NICE_NANO_V2
    select SOC_NRF52840_QIAA
```

## boards/nicekeyboards/nice_nano/nice_nano_v2_defconfig
```kconfig
# SPDX-License-Identifier: MIT

# Enable MPU
CONFIG_ARM_MPU=y

CONFIG_HW_STACK_PROTECTION=y

# Use pinctrl
CONFIG_PINCTRL=y

# enable GPIO
CONFIG_GPIO=y

# UF2
CONFIG_USE_DT_CODE_PARTITION=y
CONFIG_BUILD_OUTPUT_UF2=y

# Enable UART driver
CONFIG_SERIAL=y

# Enable console
CONFIG_CONSOLE=y

# Enable USB Support
CONFIG_USB_DEVICE_STACK=y

# Logger cannot use itself to log
CONFIG_USB_CDC_ACM_LOG_LEVEL_OFF=y
```
